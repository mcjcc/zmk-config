## config/boards/shields/microdox/Kconfig.defconfig
```kconfig
if SHIELD_MICRODOX_V2_LEFT

config ZMK_KEYBOARD_NAME
  default "Microdox"

config ZMK_SPLIT_BLE_ROLE_CENTRAL
  default y

endif

if SHIELD_MICRODOX_V2_LEFT || SHIELD_MICRODOX_V2_RIGHT

config ZMK_SPLIT
    default y

endif
```

## config/boards/shields/microdox_v2/Kconfig.defconfig
```kconfig
if MICRODOX_V2_LEFT

config ZMK_KEYBOARD_NAME
  default "Microdox v2"

config ZMK_SPLIT_BLE_ROLE_CENTRAL
  default y

endif

if MICRODOX_V2_LEFT || MICRODOX_V2_RIGHT

config ZMK_SPLIT
    default y

endif
```

## config/boards/shields/microdox_v2/Kconfig.shield
```kconfig
config MICRODOX_V2_LEFT
    def_bool $(shields_list_contains,microdox_v2_left)

config MICRODOX_V2_RIGHT
    def_bool $(shields_list_contains,microdox_v2_right)
```

## config/boards/shields/rhymestone/Kconfig.defconfig
```kconfig
if SHIELD_RHYMESTONE_LEFT

config ZMK_KEYBOARD_NAME
  default "Rhymestone"

config ZMK_SPLIT_BLE_ROLE_CENTRAL
  default y

endif

if SHIELD_RHYMESTONE_LEFT || SHIELD_RHYMESTONE_RIGHT

config ZMK_SPLIT
    default y

endif
```

## config/boards/shields/rhymestone/Kconfig.shield
```kconfig
config SHIELD_RHYMESTONE_LEFT
    def_bool $(shields_list_contains,rhymestone_left)

config SHIELD_RHYMESTONE_RIGHT
    def_bool $(shields_list_contains,rhymestone_right)
```
